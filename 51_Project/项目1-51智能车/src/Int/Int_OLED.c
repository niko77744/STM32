#include <STDIO.H>
#include "Int_OLED.h"

// 定义字模数组 code 关键字表示该数据放入程序空间
static code u8 s_fonts[][16] = {
    0x00, 0x00, 0x00, 0x00, 0x00, 0x00, 0x00, 0x00,
    0x00, 0x00, 0x00, 0x00, 0x00, 0x00, 0x00, 0x00, //  0

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    0x00, 0x00, 0x00, 0x00, 0x00, 0x00, 0x00, 0x00, //~ 94
};

/**
 * @brief 向OLED写入多个数据 分为命令和数据
 *
 * @param bytes 要写入的数据/命令集合
 * @param len  要写入长度
 * @param bit is_data 1表示数据 0表示命令
 */
static void Int_OLED_WriteBytes(u8* bytes, u8 len, bit is_data)
{
    u8 i;

    // 发送启动信号
    Dri_IIC_Start();

    // 发送OLED地址和写标志，并接收应答引号
    Dri_IIC_SendByte(OLED_ADDR);
    Dri_IIC_ReceiveAck();

    // 发送控制字节，确定后续是数据还是命令; 都设置为连续发送
    if (is_data)
    {
        // 控制字节指定后续发的数据， 0100 0000
        Dri_IIC_SendByte(0x40);
    }
    else
    {
        // 控制字节指定后续发的命令，0000 0000
        Dri_IIC_SendByte(0x00);
    }
    Dri_IIC_ReceiveAck();

    // 依次发送 命令或数据
    for (i = 0; i < len; i++)
    {
        Dri_IIC_SendByte(bytes[i]);
        Dri_IIC_ReceiveAck();
    }

    // 发送结束信号
    Dri_IIC_End();
}

// 发送命令
static void Int_OLED_WriteCommand(u8* bytes, u8 len)
{
    Int_OLED_WriteBytes(bytes, len, 0);
}

// 发送数据
static void Int_OLED_WriteData(u8* bytes, u8 len)
{
    Int_OLED_WriteBytes(bytes, len, 1);
}

// 设置页地址和列地址 并发送命令; 两个参数分别是 页地址和列地址
static void Int_OLED_SetAddress(u8 page, u8 column)
{
    // 定义数组
    u8 address_cmds[3];
    // 确定页地址
    address_cmds[0] = 0xB0 | page;
    // 确定列地址
    address_cmds[1] = 0x0F & column;        // 列地址的低4位
    address_cmds[2] = 0x10 | (column >> 4); // 列地址的高3位
    // 写入命令
    Int_OLED_WriteCommand(address_cmds, 3);
}

/**
 * @brief OLED 初始化
 *
 */
void Int_OLED_Init()
{
    // 定义数组，存放控制命令
    u8 commands[6];

    // 添加关闭屏幕的命令
    commands[0] = 0xAE;

    // 行的重映射
    commands[1] = 0xC8;
    // 列的重映射
    commands[2] = 0xA1;

    // 电荷泵增加
    commands[3] = 0x8D;
    commands[4] = 0x14;

    // 打开屏幕
    commands[5] = 0xAF;

    // 写入命令
    Int_OLED_WriteCommand(commands, 6);
}

/**
 * @brief OLED 清屏
 *
 */
void Int_OLED_Clear()
{
    u8 i;
    // 定义数组，要写入的数据
    u8 datas[16] = { 0 };

    // ------------------------------------------------------------------------
    // 设置要发送的命令
    u8 cmds[2];
    // 设置寻址方式为水平寻址
    cmds[0] = 0x20;
    cmds[1] = 0x00;
    // 默认页范围是从第一页到最后一页，默认列范围从第一列到最后一列，所以默认选定的区域就是整个屏幕； 我们无需设置
    // 写入命令
    Int_OLED_WriteCommand(cmds, 2);

    // -------------------------------------------------------------------------
    // 向GDDRAM写入数据
    // 循环 64 次，每次写入 16 个字节，可以写满整个 GDDRAM
    for (i = 0; i < 64; i++)
    {
        Int_OLED_WriteData(datas, 16);
    }
}

/**
 * @brief OLED 显示字符串
 *
 * @param x X坐标
 * @param y Y坐标
 * @param str 要写入的字符串
 */
void Int_OLED_DisplayStr(u8 x, u8 y, u8* str)
{
    u8 i;

    // 第一步 设置寻址方式为页寻址------------------------------------------
    // 保存命令
    u8 cmds[2];
    // 设置寻址方式为页寻址
    cmds[0] = 0x20;
    cmds[1] = 0x02;
    Int_OLED_WriteCommand(cmds, 2);

    // 第二步 显示字符串的上半部分 --------------------------------------------
    // 确定页地址和列地址并发送
    Int_OLED_SetAddress(y * 2, x * 8);
    /*
        循环条件1： 没有到达页边界 x + i < 16
        循环条件2： 字符串没有到头 str[i] != 0
    */
    for (i = 0; (str[i] != 0) && (x + i < 16); i++)
    {
        // 写入数据
        Int_OLED_WriteData(s_fonts[str[i] - 32], 8);
    }

    // 第三步 显示字符串的下半部分 --------------------------------------------
    // 确定页地址和列地址并发送
    Int_OLED_SetAddress(y * 2 + 1, x * 8);
    /*
        循环条件1： 没有到达页边界 x + i < 16
        循环条件2： 字符串没有到头 str[i] != 0
    */
    for (i = 0; (str[i] != 0) && (x + i < 16); i++)
    {
        // 写入数据
        Int_OLED_WriteData(s_fonts[str[i] - 32] + 8, 8);
    }
}


/**
 * @brief OLED 显示数字
 *
 * @param x X坐标
 * @param y Y坐标
 * @param num 要写入的数字
 */
void Int_OLED_DisplayNum(u8 x, u8 y, long num)
{
    // 定义字符串
    u8 str[12];
    // 将 num 转为字符串存入 str
    sprintf(str, "%ld", num);
    // 显示str
    Int_OLED_DisplayStr(x, y, str);
}